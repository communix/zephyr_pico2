## CMakeLists.txt
```
# SPDX-License-Identifier: Apache-2.0

cmake_minimum_required(VERSION 3.20.0)
find_package(Zephyr REQUIRED HINTS $ENV{ZEPHYR_BASE})
project(message_queue)

target_sources(app PRIVATE src/main.c)
```

## prj.conf
```kconfig
# Application specific configration
CONFIG_GPIO=y
CONFIG_TEST_RANDOM_GENERATOR=y
CONFIG_TEST_CSPRNG_GENERATOR=y
CONFIG_COUNTER=y # For using hardware timer as a counter
CONFIG_POLL=y # For using k_poll_signal in the sensor aggregation thread

# RP pico logging configration
CONFIG_LOG=y
CONFIG_USB_DEVICE_INITIALIZE_AT_BOOT=y
```

## src/main.c
```c
/**
 * Message Queue Example Application for Zephyr RTOS on Raspberry Pi Pico2
 * @file main.c
 * @brief A simple "Message Queue" application for Zephyr RTOS on Raspberry Pi Pico2
 */

#include <string.h>
#include <zephyr/kernel.h>
#include <zephyr/device.h>
#include <zephyr/drivers/gpio.h>
#include <zephyr/logging/log.h>
#include <zephyr/drivers/counter.h>
#include <zephyr/random/random.h>
// For the version control
#include <app_version.h>
#include "main.h"

LOG_MODULE_REGISTER(main, LOG_LEVEL);

static const struct gpio_dt_spec led = GPIO_DT_SPEC_GET(LED0_NODE, gpios);
static const struct device *timer = DEVICE_DT_GET(HW_TIMER);

// Mutex for synchronizing access to the random number generator
struct k_mutex csrand_mutex;

/** @brief Sensor data structure */
typedef struct {
    uint32_t header; // This has the sensor ID.
    uint32_t sequence_num; // This is the sequence number of the sensor data, which increments with each new data generated by the sensor.
    uint32_t data; // This is the actual sensor data value, which can be a random value for simulation purposes.
} sensor_data_t;

/** @brief Aggregated data structure */
typedef struct {
    uint64_t timestamp; // This is the timstamp when the data was aggregated, which can be obtained using k_uptime_get() in milliseconds.
    uint32_t sum_sensor1; // This is the actual sensor data value, which can be a random value for simulation purposes.
    uint32_t num_sensor1; // This is the number of sensor data received from sensor 1, which is used to calculate the average value for sensor 1.
    uint32_t sum_sensor2; // This is the actual sensor data value, which can be a random value for simulation purposes.
    uint32_t num_sensor2; // This is the number of sensor data received from sensor 2, which is used to calculate the average value for sensor 2.
    uint32_t sum_sensor3; // This is the actual sensor data value, which can be a random value for simulation purposes.
    uint32_t num_sensor3; // This is the number of sensor data received from sensor 3, which is used to calculate the average value for sensor 3.
} agg_data_t;

/** @brief buffers and msgq, pipe */
uint8_t sensor_data_buffer[sizeof(sensor_data_t) * SENSOR_DATA_MSGQ_SIZE];
uint8_t __aligned(4) aggregated_data_buffer[sizeof(agg_data_t) * AGGREGATED_DATA_PIPE_SIZE];
struct k_msgq sensor_data_msgq; // Message queue for sending sensor data from sensor threads to the data aggregation thread
struct k_pipe sensor_data_pipe; // Pipe for sending aggregated data to the sensor core thread

/** @brief system event, Event for signaling system events like timer expiration*/
struct k_event system_event;

/** @brief thread structures */
struct k_thread sensor1_s;
struct k_thread sensor2_s;
struct k_thread sensor3_s;
struct k_thread data_agg_s;
struct k_thread sensor_core_s;

/** @brief thread stacks */
K_THREAD_STACK_DEFINE(sensor1_stack, STACKSIZE);
K_THREAD_STACK_DEFINE(sensor2_stack, STACKSIZE);
K_THREAD_STACK_DEFINE(sensor3_stack, STACKSIZE);
K_THREAD_STACK_DEFINE(data_agg_stack, STACKSIZE);
K_THREAD_STACK_DEFINE(sensor_core_stack, STACKSIZE);

/** @brief k_poll_event array for the sensor aggregation thread to wait for the timer event using k_poll() and message_queue data */
struct k_poll_signal timer_signal;
struct k_poll_event poll_events[2];

/**
 * @brief Set up the hardware timer with the specified callback and time interval
 * @param dev Pointer to the timer device
 * @param callback Timer callback function to be called when the timer expires
 * @param time_ms Time interval in milliseconds for the timer alarm
 * @return 0 on success, -1 on failure
 */
static int hw_timer_setup(const struct device *dev, counter_alarm_callback_t callback, uint32_t time_ms)
{
    if (!device_is_ready(dev)) {
        LOG_ERR("Error: Timer device %s is not ready", dev->name);
        return -1;
    }

    struct counter_alarm_cfg alarm_cfg = {
        .flags = 0,
        .ticks = counter_us_to_ticks(dev, time_ms * 1000),
        .callback = callback,
        .user_data = NULL
    };

    int ret = counter_set_channel_alarm(dev, 0, &alarm_cfg);
    if (ret < 0) {
        LOG_ERR("Error %d: failed to set timer alarm", ret);
        return -1;
    }

    return 0;
}

/**
 * @brief Timer callback function.
 * @param dev Pointer to the timer device
 * @param chan_id Channel ID
 * @param ticks Number of ticks
 * @param user_data User data pointer
 */
static void timer_callback(const struct device *dev, uint8_t chan_id, uint32_t ticks, void *user_data)
{
    /* Toggle the LED state */
    gpio_pin_toggle_dt(&led);
    LOG_DBG("Timer callback triggered: toggled LED, ticks: %u", ticks);
    k_event_set(&system_event, EVENT_1S_TIMER_EXPIRED); // Set the timer event bit in the system event to signal the sensor aggregation thread that the timer has expired
    hw_timer_setup(timer, timer_callback, TIMER_INTERVAL_MS); // Re-arm the timer for the next interval
}

/**
 * @brief Get a random time in milliseconds for the next LED on/off interval.
 * This function uses the sys_csrand_get API to obtain a random value and calculates
 * a random time between 100 ms and 1000 ms. If the random value cannot be obtained,
 * it returns a default time provided as an argument.
 *
 * @param default_time_ms The default time in milliseconds to use if random value retrieval fails.
 * @return A random time in milliseconds for the next LED interval.
 */

uint32_t get_random_time_ms(uint32_t default_time_ms) {
    uint32_t rand_value;
    uint32_t rand_time_ms = default_time_ms; // Output random time in milliseconds
    if (sys_csrand_get(&rand_value, sizeof(rand_value)) < 0) {
        LOG_ERR("Failed to get random value for next timer interval, using default %d ms", default_time_ms);
    } else {
        // Randomize the next timer interval between 100 ms and 1000 ms
        rand_time_ms = 100 + (rand_value % 401); // 100 to 500 ms
    }
    return rand_time_ms;
}

/**
 * @brief Get random sensor data value.
 * This function uses the sys_csrand_get API to obtain a random value and calculates
 * a random sensor data value between 0 and 10000. If the random value cannot be obtained,
 * it returns a default value of 0.
 *
 * @return A random sensor data value.
 */

uint32_t get_random_sensor_data() {
    uint32_t output = 0;
    uint32_t rand_value;
    if (k_mutex_lock(&csrand_mutex, K_MSEC(MUTEX_TIMEOUT_MS)) == 0) {
        if (sys_csrand_get(&rand_value, sizeof(rand_value)) < 0) {
            LOG_ERR("Failed to get random value for next timer interval, using default value, %d", output);
        } else {
            k_mutex_unlock(&csrand_mutex);
            output = rand_value % 10001; // 0 to 10000
        }
    } else {
        LOG_ERR("Cannot get CSRAND, using default value, %d", output);
    }
    return output;
}

void sensor_main(void *p1, void *p2, void *p3) {
    const uint32_t *p_sensor_id = (const uint32_t *)p1;
    uint32_t sequence_num = 0;
    LOG_INF("Sensor %u: Waiting for SYSTEM ON event to start...", *p_sensor_id);
    // Waiting for the SYSTEM ON event before starting the sensor data generation
    while(1) {
        uint32_t events = k_event_wait(&system_event, EVENT_SYSTEM_ON, false, K_FOREVER);
        if (events & EVENT_SYSTEM_ON) {
            LOG_INF("Sensor %u: Received SYSTEM ON event, starting data generation...", *p_sensor_id);
            break;
        }
    }
    while (1) {
        sensor_data_t sensor_data = {
            .header = *p_sensor_id,
            .sequence_num = sequence_num,
            .data = get_random_sensor_data(),
        };
        k_msgq_put(&sensor_data_msgq, &sensor_data, K_FOREVER);
        LOG_INF("Sensor %u: Generated data with sequence number %u and value %u", *p_sensor_id, sensor_data.sequence_num, sensor_data.data);
        sequence_num++;
        k_sleep(K_MSEC(get_random_time_ms(500)));
    }
}

void data_agg_main(void *p1, void *p2, void *p3) {
    agg_data_t agg_data;
    memset(&agg_data, 0, sizeof(agg_data)); // Reset the aggregated data structure before starting the aggregation loop
    sensor_data_t sensor_data_buf;
    LOG_INF("Data Aggregation Thread: Waiting for SYSTEM ON event to start...");
    // Waiting for the SYSTEM ON event before starting the sensor data generation
    k_poll_event_init(&poll_events[0], K_POLL_TYPE_SIGNAL, K_POLL_MODE_NOTIFY_ONLY, &timer_signal);
    k_poll_event_init(&poll_events[1], K_POLL_TYPE_MSGQ_DATA_AVAILABLE, K_POLL_MODE_NOTIFY_ONLY, &sensor_data_msgq);

    while(1) {
        uint32_t events = k_event_wait(&system_event, EVENT_SYSTEM_ON, false, K_FOREVER);
        if (events & EVENT_SYSTEM_ON) {
            LOG_INF("Data Aggregation Thread: Received SYSTEM ON event, starting data generation...");
            break;
        }
    }
    while (1) {
        int ret = k_poll(poll_events, 2, K_FOREVER);
        if (ret < 0) {
            LOG_ERR("Error %d: failed to poll events", ret);
            continue;
        }
        if (poll_events[0].state & K_POLL_STATE_SIGNALED) {
            unsigned int signaled;
            int result_val;
            k_poll_signal_check(&timer_signal, &signaled, &result_val);
            if ((signaled > 0) && (result_val == EVENT_1S_TIMER_EXPIRED)) {
                LOG_INF("Data Aggregation Thread: Timer event(k_poll_signal) received, signaled=%u, result_val=%d", signaled, result_val);
                // Send agg_data to the sensor core thread using pipe
                agg_data.timestamp = k_uptime_get();
                size_t data_length = sizeof(agg_data);
                size_t written = 0;
                while (written < data_length) {
                    int ret = k_pipe_write(&sensor_data_pipe, ((uint8_t *)&agg_data) + written, data_length - written, K_NO_WAIT);
                    if (ret < 0) {
                        if (ret == -EAGAIN) {
                            // Pipe is full, wait for some time before retrying
                            k_sleep(K_MSEC(10));
                            continue;
                        } else {
                            LOG_ERR("Failed to put aggregated data to pipe, error %d", ret);
                            break;
                        }
                    }
                    written += ret;
                }

                if (written == data_length) {
                    LOG_INF("Data Aggregation Thread: Sent aggregated data with timestamp %llu ms, Sensor1 sum=%u from %u samples, Sensor2 sum=%u from %u samples, Sensor3 sum=%u from %u samples",
                            agg_data.timestamp,
                            agg_data.sum_sensor1, agg_data.num_sensor1,
                            agg_data.sum_sensor2, agg_data.num_sensor2,
                            agg_data.sum_sensor3, agg_data.num_sensor3);
                }
                memset(&agg_data, 0, sizeof(agg_data)); // Reset the aggregated data structure after sending the data to the sensor core thread
                k_poll_signal_reset(&timer_signal);
                poll_events[0].state = K_POLL_STATE_NOT_READY; // Clear the signal state for the timer event
            } else {
                LOG_WRN("Data Aggregation Thread: Received unexpected signal, signaled=%u, result_val=%d", signaled, result_val);
                poll_events[0].state = K_POLL_STATE_NOT_READY; // Clear the signal state for the timer event
            }
        }
        if (poll_events[1].state & K_POLL_STATE_MSGQ_DATA_AVAILABLE) {
            LOG_DBG("Data Aggregation Thread: Sensor data available in message queue, starting data aggregation...");
            ret = k_msgq_get(poll_events[1].msgq, &sensor_data_buf, K_NO_WAIT);
            if (ret < 0) {
                LOG_ERR("Error %d: failed to get sensor data from message queue", ret);
            } else {
                LOG_INF("Data Aggregation Thread: Received sensor data from Sensor %u with sequence number %u and value %u",
                        sensor_data_buf.header, sensor_data_buf.sequence_num, sensor_data_buf.data);
                if (sensor_data_buf.header == 1) {
                    agg_data.sum_sensor1 += sensor_data_buf.data;
                    agg_data.num_sensor1++;
                } else if (sensor_data_buf.header == 2) {
                    agg_data.sum_sensor2 += sensor_data_buf.data;
                    agg_data.num_sensor2++;
                } else if (sensor_data_buf.header == 3) {
                    agg_data.sum_sensor3 += sensor_data_buf.data;
                    agg_data.num_sensor3++;
                }
            }
            poll_events[1].state = K_POLL_STATE_NOT_READY; // Clear the signal state for the timer event
        }
    }
}

void sensor_core_main(void *p1, void *p2, void *p3) {
    agg_data_t agg_data;
    LOG_INF("Sensor Core Thread: Waiting for SYSTEM ON event to start...");
    while(1) {
        uint32_t events = k_event_wait(&system_event, EVENT_SYSTEM_ON, false, K_FOREVER);
        if (events & EVENT_SYSTEM_ON) {
            LOG_INF("[Sensor Core Thread] Received SYSTEM ON event, starting data generation...");
            break;
        }
    }
    while (1) {
        size_t data_length = sizeof(agg_data);
        size_t read = 0;
        while (read < data_length) {
            int ret = k_pipe_read(&sensor_data_pipe, ((uint8_t *)&agg_data) + read, data_length - read, K_NO_WAIT);
            if (ret < 0) {
                if (ret == -EAGAIN) {
                    // Pipe is empty, wait for some time before retrying
                    k_sleep(K_MSEC(10));
                    continue;
                } else {
                    LOG_ERR("Failed to get aggregated data from pipe, error %d", ret);
                    break;
                }
            }
            read += ret;
        }
        if (read == data_length) {
            LOG_INF("Sensor Core Thread: Received aggregated data with timestamp %llu ms, Sensor1 sum=%u from %u samples, Sensor2 sum=%u from %u samples, Sensor3 sum=%u from %u samples",
                    agg_data.timestamp,
                    agg_data.sum_sensor1, agg_data.num_sensor1,
                    agg_data.sum_sensor2, agg_data.num_sensor2,
                    agg_data.sum_sensor3, agg_data.num_sensor3);
            LOG_INF("Sensor Core Thread: Average values - Sensor1: %u, Sensor2: %u, Sensor3: %u",
                    agg_data.num_sensor1 > 0 ? agg_data.sum_sensor1 / agg_data.num_sensor1 : 0,
                    agg_data.num_sensor2 > 0 ? agg_data.sum_sensor2 / agg_data.num_sensor2 : 0,
                    agg_data.num_sensor3 > 0 ? agg_data.sum_sensor3 / agg_data.num_sensor3 : 0);
        }
    }
}
/**
 * @brief main - Entry point for the Message Queue application
 *
 * @param void
 * @return 0 on success, non-zero on failure.
 */

int main(void)
{
    int ret;

    k_sleep(K_SECONDS(3)); // Sleep for stable log message output.

    LOG_DBG("Message Queue - version %s", APP_VERSION_STRING);
    LOG_INF("LED device: %s, pin: %d", led.port->name, led.pin);
    if (!gpio_is_ready_dt(&led)) {
        LOG_ERR("Error: LED device %s is not ready", led.port->name);
        return -1;
    }

    ret = gpio_pin_configure_dt(&led, GPIO_OUTPUT_ACTIVE);
    if (ret < 0) {
        LOG_ERR("Error %d: failed to configure LED pin %d", ret, led.pin);
        return -1;
    }

    k_mutex_init(&csrand_mutex);

    k_msgq_init(&sensor_data_msgq, sensor_data_buffer, sizeof(sensor_data_t), SENSOR_DATA_MSGQ_SIZE);
    k_pipe_init(&sensor_data_pipe, aggregated_data_buffer, sizeof(agg_data_t) * AGGREGATED_DATA_PIPE_SIZE); // Initialize the pipe with a buffer size equal to the message queue size
    const uint32_t sensor1_id = 1;
    const uint32_t sensor2_id = 2;
    const uint32_t sensor3_id = 3;
    k_tid_t sensor1_tid = k_thread_create(&sensor1_s, sensor1_stack,
                                         K_THREAD_STACK_SIZEOF(sensor1_stack),
                                         sensor_main, (void *)&sensor1_id, NULL, NULL, PRIORITY, 0, K_NO_WAIT);
    k_tid_t sensor2_tid = k_thread_create(&sensor2_s, sensor2_stack,
                                         K_THREAD_STACK_SIZEOF(sensor2_stack),
                                         sensor_main, (void *)&sensor2_id, NULL, NULL, PRIORITY, 0, K_NO_WAIT);
    k_tid_t sensor3_tid = k_thread_create(&sensor3_s, sensor3_stack,
                                         K_THREAD_STACK_SIZEOF(sensor3_stack),
                                         sensor_main, (void *)&sensor3_id, NULL, NULL, PRIORITY, 0, K_NO_WAIT);
    k_tid_t data_agg_tid = k_thread_create(&data_agg_s, data_agg_stack,
                                         K_THREAD_STACK_SIZEOF(data_agg_stack),
                                         data_agg_main, NULL, NULL, NULL, PRIORITY, 0, K_NO_WAIT);
    k_tid_t sensor_core_tid = k_thread_create(&sensor_core_s, sensor_core_stack,
                                         K_THREAD_STACK_SIZEOF(sensor_core_stack),
                                         sensor_core_main, NULL, NULL, NULL, PRIORITY, 0, K_NO_WAIT);
    // Send SYSTEM ON Event to every thread to start the system
    k_event_init(&system_event);
    k_sleep(K_SECONDS(1)); // Sleep for stable log message output.

    ret = hw_timer_setup(timer, timer_callback, TIMER_INTERVAL_MS);
    if (ret < 0) {
        LOG_ERR("Failed to set up hardware timer %s", timer->name);
        return -1;
    }
    k_event_post(&system_event, EVENT_SYSTEM_ON);

    (void)sensor1_tid; // To avoid warining
    (void)sensor2_tid; // To avoid warining
    (void)sensor3_tid; // To avoid warining
    (void)data_agg_tid; // To avoid warining
    (void)sensor_core_tid; // To avoid warining

    k_poll_signal_init(&timer_signal);

    while (1) {
        /** This is workaroud code to use k_poll object in sensor aggregation thread.
         * k_poll() does not suport k_event as of Zephyr 3.5, so we need to wait for the timer event
         * in the main thread and then post the k_poll_signal to the sensor aggregation thread.
         * In a real application it's better to send k_poll_signal directly from the timer callback,
         * but we use this workaround to show how to handle k_poll() and k_event together in the sensor aggregation thread.
         */
        k_event_wait(&system_event, EVENT_1S_TIMER_EXPIRED, false, K_FOREVER);
        LOG_DBG("Main thread: Timer event received, posting signal to sensor aggregation thread...");
        k_poll_signal_raise(&timer_signal, EVENT_1S_TIMER_EXPIRED); // Use the same bits for k_event and k_poll_signal to simplify the logic in the sensor aggregation thread.
        k_event_set_masked(&system_event, 0, EVENT_1S_TIMER_EXPIRED); // Clear the timer event bit in the system event after raising the k_poll_signal.
    }
    return 0;
}
```

## src/main.h
```c
/**
 * @file main.h
 * @brief Header file for the application main.c
 *
 * @author Changjae Kim
 * @date 2026-05-03
 */

/** @brief Default log level for the application. Set to LOG_LEVEL_DBG for detailed debug output. */
#define LOG_LEVEL LOG_LEVEL_DBG
/** @brief The devicetree node identifier for the "led0" alias. */
#define LED0_NODE DT_ALIAS(led0)
/** @brief The devicetree node identifier for the "timer0" label. */
#define HW_TIMER DT_NODELABEL(timer0)

/** @brief Stack size for the threads */
#define STACKSIZE 2048
/** @brief Priority for the LED on thread */
#define PRIORITY 7
/** @brief Mutex timeout in milliseconds */
#define MUTEX_TIMEOUT_MS 100

#define TIMER_INTERVAL_MS 1000 // Timer interval in milliseconds

#define EVENT_SYSTEM_ON             1 // BIT 0 
#define EVENT_1S_TIMER_EXPIRED      2 // BIT 1

#define SENSOR_DATA_MSGQ_SIZE       10 // Maximum number of messages in the queue
#define AGGREGATED_DATA_PIPE_SIZE   10 // Maximum number of messages in the pipe
```
